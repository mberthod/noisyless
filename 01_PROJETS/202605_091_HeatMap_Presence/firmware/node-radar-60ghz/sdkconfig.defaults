## 01_PROJETS/202605_091_HeatMap_Presence/firmware/node-radar-60ghz/sdkconfig.defaults
```kconfig
CONFIG_FREERTOS_HZ=1000
CONFIG_ESP32S3_DEFAULT_CPU_FREQ_240=y
CONFIG_ESP_MAIN_TASK_STACK_SIZE=8192
CONFIG_ESP32_WIFI_STATIC_RX_BUFFER_NUM=10
CONFIG_ESP32_WIFI_DYNAMIC_RX_BUFFER_NUM=32
CONFIG_PM_ENABLE=y
CONFIG_FREERTOS_USE_TICKLESS_IDLE=y
CONFIG_ESP_WIFI_ESPNOW_ENABLE=y
```

## 01_PROJETS/202605_091_HeatMap_Presence/firmware/node-tof-esp32s3/sdkconfig.defaults
```kconfig
# ESP-IDF Kconfig defaults — optimized for battery
CONFIG_FREERTOS_HZ=1000
CONFIG_ESP32S3_DEFAULT_CPU_FREQ_240=y
CONFIG_ESP_MAIN_TASK_STACK_SIZE=8192
CONFIG_PM_ENABLE=y
CONFIG_FREERTOS_USE_TICKLESS_IDLE=y
CONFIG_ESP_WIFI_STATIC_RX_BUFFER_NUM=8
CONFIG_ESP_WIFI_DYNAMIC_RX_BUFFER_NUM=16
CONFIG_ESP_WIFI_STATIC_TX_BUFFER_NUM=4
CONFIG_LWIP_TCPIP_TASK_STACK_SIZE=3072
CONFIG_COMPILER_OPTIMIZATION_SIZE=y
CONFIG_BOOTLOADER_COMPILER_OPTIMIZATION_SIZE=y
```
